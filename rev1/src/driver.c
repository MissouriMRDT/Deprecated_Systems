/***************************************************************************
*                                   INLCUDES                               *
***************************************************************************/

#include <gpio.h>
#include <interrupt.h>
#include <msp432.h>
#include <wdt_a.h>

#include <msp_pin.h>

#include "cells.h"
#include "ltc_6802.h"
#include "status_monitoring.h"

/***************************************************************************
*                             LITERAL CONSTANTS                            *
***************************************************************************/

/***************************************************************************
*                                   MACROS                                 *
***************************************************************************/

/***************************************************************************
*                                    TYPES                                 *
***************************************************************************/

/***************************************************************************
*                              MEMORY CONSTANTS                            *
***************************************************************************/

/***************************************************************************
*                                   CLASSES                                *
***************************************************************************/

/***************************************************************************
*                                  VARIABLES                               *
***************************************************************************/

c_bms_pack              batery_pack;/* main battery pack info       */
uint16_t                pack_discarge;
                                    /* current pack discharge       */
uint16_t                pack_voltage;
                                    /* current pack voltage         */

/***************************************************************************
*                                 PROCEDURES                               *
***************************************************************************/

e_error_states system_init
	(
		void
	);


/*******************************************************************
*
*	PROCEDURE NAME:
*		main
*
*	DESCRIPTION:
*		Main entry point for the program
*
*******************************************************************/

int main
	(
		void
	)
{
    WDT_A_holdTimer();
    Interrupt_enableSleepOnIsrExit();

    while( 1 )
    {
    	if( status_is_estop_1_active() )
    	{
    		status_turn_rover_off();
    	}
    	else
    	{
    		status_turn_rover_on();
    	}
    }

}	/* main() */


/*******************************************************************
*
*	PROCEDURE NAME:
*		system_init
*
*	DESCRIPTION:
*		Initializes the individual modules
*
*******************************************************************/

e_error_states system_init
	(
		void
	)
{
	/*------------------------------------------------------
						Local Variables
	------------------------------------------------------*/
	static uint8_t      err_state;  /* current error state          */

	/*-----------------------------------
	Preform power-up on the LTC
	-----------------------------------*/
	err_state = ltc_powerup();
	if( err_state != ERROR_NO_ERROR )
	{
		return( err_state );
	}

	/*-----------------------------------
	Preform powreup on the status pins
	-----------------------------------*/
	err_state = status_powerup();
	if( err_state != ERROR_NO_ERROR )
	{
		return( err_state );
	}

	return ERROR_NO_ERROR;

}	/* system_init() */
